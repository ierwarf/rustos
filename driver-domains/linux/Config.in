## driver-domains/linux/Config.in
```kconfig
# SPDX-License-Identifier: MIT

menu "RustOS Linux driver-domain components"

source "$BR2_EXTERNAL_RUSTOS_LINUX_DVM_PATH/package/rustos-dvm-agent/Config.in"
source "$BR2_EXTERNAL_RUSTOS_LINUX_DVM_PATH/package/rustos-dvm-block/Config.in"
source "$BR2_EXTERNAL_RUSTOS_LINUX_DVM_PATH/package/rustos-dvm-display/Config.in"
source "$BR2_EXTERNAL_RUSTOS_LINUX_DVM_PATH/package/rustos-dvm-net/Config.in"
source "$BR2_EXTERNAL_RUSTOS_LINUX_DVM_PATH/package/rustos-dvm-nvidia-open/Config.in"

endmenu
```

## driver-domains/linux/package/rustos-dvm-agent/Config.in
```kconfig
# SPDX-License-Identifier: MIT

config BR2_PACKAGE_RUSTOS_DVM_AGENT
	bool "rustos-dvm-agent"
	help
	  Bounded KVM-vsock control agent for a RustOS Linux driver domain.
	  It exposes only host-authenticated health and device inventory.
```

## driver-domains/linux/package/rustos-dvm-block/Config.in
```kconfig
# SPDX-License-Identifier: MIT

config BR2_PACKAGE_RUSTOS_DVM_BLOCK
	bool "rustos-dvm-block"
	help
	  Fixed, address-free block relay for the isolated RustOS Linux storage
	  driver domain. A dedicated MSI-X UIO adapter binds only the exact
	  RSDVMBL1 aperture, maps that bounded aperture write-back, and exposes
	  only peer-0/vector-0 notification through UIO irqcontrol. The userspace
	  relay owns no PCI controller MMIO; Linux nvme/ahci and the block layer
	  remain the sole physical-device implementation.
```

## driver-domains/linux/package/rustos-dvm-display/Config.in
```kconfig
# SPDX-License-Identifier: MIT

config BR2_PACKAGE_RUSTOS_DVM_DISPLAY

	bool "rustos-dvm-display"
	depends on BR2_PACKAGE_HAS_LIBEGL
	depends on BR2_PACKAGE_HAS_LIBGLES
	depends on BR2_PACKAGE_HAS_LIBGBM
	select BR2_PACKAGE_LIBDRM
	help
	  Unprivileged-in-protocol display consumer for the RustOS Linux driver
	  domain. It maps only the fixed ivshmem framebuffer contract, receives
	  host-published frames through a fixed-header, one-vector MSI-X UIO
	  doorbell, and uses the DVM-owned DRM/KMS device for pinned DirtyFB
	  scanout. It also ships the private fixed-command GPU executor proof used
	  before the application graphics ABI is admitted. That proof accepts no
	  raw shaders, GPU addresses, or command buffers and rejects software Mesa.
	  The package ships the dedicated ivshmem adapter because generic
	  UIO accepts only INTx and cannot service the doorbell. It never polls the
	  shared framebuffer or accepts a guest-selected control address.
```

## driver-domains/linux/package/rustos-dvm-net/Config.in
```kconfig
# SPDX-License-Identifier: MIT

config BR2_PACKAGE_RUSTOS_DVM_NET
	bool "rustos-dvm-net"
	depends on BR2_LINUX_KERNEL
	help
	  Bounded raw Ethernet relay between the DVM-owned Linux NIC and the
	  host-created RustOS two-ring ivshmem network transport. The package
	  includes the exact-layout WB UIO adapter used by the relay.
```

## driver-domains/linux/package/rustos-dvm-nvidia-open/Config.in
```kconfig
# SPDX-License-Identifier: MIT

config BR2_PACKAGE_RUSTOS_DVM_NVIDIA_OPEN
	bool "rustos-dvm-nvidia-open"
	depends on BR2_x86_64
	depends on BR2_LINUX_KERNEL
	help
	  Pinned NVIDIA open kernel-module flavor and matching GSP firmware
	  for a physical display driver domain.  Only nvidia, nvidia-modeset,
	  and nvidia-drm are built; CUDA/UVM and the NVIDIA userspace stack are
	  deliberately excluded from this KMS-only appliance.

	  The firmware is under the NVIDIA Software License and is marked
	  non-redistributable by this package.  Product distribution requires
	  a separately satisfied NVIDIA redistribution license gate.
```
